/*
*
* File: dft3.ino
* Purpose: DFT with 16bit DDS and 10bit LUT
* Version: 1.0.0
* Date: 13-08-2020
* Created by: Martin Stokroos
* URL: https://github.com/MartinStokroos/FFTA
*
* MIT License
*
* Copyright (c) 2020 Martin Stokroos
*
* Permission is hereby granted, free of charge, to any person obtaining a copy
* of this software and associated documentation files (the "Software"), to deal
* in the Software without restriction, including without limitation the rights
* to use, copy, modify, merge, publish, distribute, sublicense, and/or sell
* copies of the Software, and to permit persons to whom the Software is
* furnished to do so, subject to the following conditions:
*
* The above copyright notice and this permission notice shall be included in all
* copies or substantial portions of the Software.
*
* THE SOFTWARE IS PROVIDED "AS IS", WITHOUT WARRANTY OF ANY KIND, EXPRESS OR
* IMPLIED, INCLUDING BUT NOT LIMITED TO THE WARRANTIES OF MERCHANTABILITY,
* FITNESS FOR A PARTICULAR PURPOSE AND NONINFRINGEMENT. IN NO EVENT SHALL THE
* AUTHORS OR COPYRIGHT HOLDERS BE LIABLE FOR ANY CLAIM, DAMAGES OR OTHER
* LIABILITY, WHETHER IN AN ACTION OF CONTRACT, TORT OR OTHERWISE, ARISING FROM,
* OUT OF OR IN CONNECTION WITH THE SOFTWARE OR THE USE OR OTHER DEALINGS IN THE
* SOFTWARE.
*
*/

#define NSAMPL 8
//int x[] = { 1, 0, 0, 0, 0, 0, 0, 0 };
int x[] = { 0, 1, 0, 0, 0, 0, 0, 0 };

//#define NSAMPL 16
//int x[] = { 0, 1, 0, 0, 0, 0, 0, 0, 0, 0, 0, 0, 0, 0, 0, 0 };

//#define NSAMPL 32
//int x[] = { 0, 1, 0, 0, 0, 0, 0, 0, 0, 0, 0, 0, 0, 0, 0, 0, 0, 0, 0, 0, 0, 0, 0, 0, 0, 0, 0, 0, 0, 0, 0, 0 };

//#define NSAMPL 64
//int x[] = { 0, 1, 0, 0, 0, 0, 0, 0, 0, 0, 0, 0, 0, 0, 0, 0, 0, 0, 0, 0, 0, 0, 0, 0, 0, 0, 0, 0, 0, 0, 0, 0, \
            0, 0, 0, 0, 0, 0, 0, 0, 0, 0, 0, 0, 0, 0, 0, 0, 0, 0, 0, 0, 0, 0, 0, 0, 0, 0, 0, 0, 0, 0, 0, 0 };

#define RANGE 65536  //phase accumulator range = 2^16.
#define PHASE_OFFSET_90 16384


const int sin_lut1024[] PROGMEM = { // range from -512 to 511?
  0, 3, 6, 9, 13, 16, 19, 22,
  25, 28, 31, 34, 38, 41, 44, 47,
  50, 53, 56, 59, 63, 66, 69, 72,
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  -25, -22, -19, -16, -13, -9, -6, -3
};



int NS = NSAMPL;
long ReX[NSAMPL];
long ImX[NSAMPL];

int L, K, M, N;
double DC, A;
unsigned long t;

unsigned int deltaPhase;
unsigned int phaseAccu;
unsigned int phaseIdxI;
unsigned int phaseIdxQ;


void setup() {
  Serial.begin(115200);
}


void loop() {
  L = NS-1; //full DFT
  //L = (int)(NS/2); //single sided spectrum

  Serial.print("\nDFT t(us)= ");  
  t = micros();
  for(K=0; K<=L; K++)
    {
    ReX[K] = 0;
    ImX[K] = 0;
    deltaPhase = (unsigned long)(RANGE/NS)*K;
    phaseIdxI=0;
    phaseIdxQ=256;

    for(N=0; N<NS; N++)
      {
      //Serial.println(phaseIdxI);
      //Serial.println((int)(pgm_read_word(sin_lut1024+phaseIdxI)-0x1FF));
      ReX[K] += x[N] * (int)pgm_read_word(sin_lut1024+phaseIdxQ); //cos multiplier
      ImX[K] += x[N] * (int)pgm_read_word(sin_lut1024+phaseIdxI); //sin multiplier
      //phaseAccu += deltaPhase; //negative frequencies first
      phaseAccu -= deltaPhase; //positive frequencies first
      phaseIdxI = phaseAccu>>6;
      phaseIdxQ = (phaseAccu+PHASE_OFFSET_90)>>6; //adding a fixed phase offset for cos.
      }
  }
  Serial.println(micros()-t);

  for(K=0; K<=L; K++)
    {
    Serial.print((double)ReX[K]/511, 2);
    //Serial.print((double)ReX[K]/(511*NS), 2);
    Serial.print("\t");
    Serial.println((double)ImX[K]/511, 2);
    //Serial.println((double)ImX[K]/(511*NS), 2);    
    }

  DC = (double)ReX[0]/(512*NS);
  Serial.println();
  Serial.println(DC, 3);

  Serial.println();
  //t = micros();
  for(M=1; M<=L; M++)
    {
    A = sqrt( sq(ImX[M])+sq(ReX[M]) ) / (511*NS);
    Serial.println(A, 3);
    }
  //Serial.print("ABS t(us)= ");  
  //Serial.println(micros()-t);

  while(1) {};
}
